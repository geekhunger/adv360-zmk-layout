## Kconfig
```kconfig
menu "Geekhunger Advantage 360 layout"

config ADV360_PROFILE_OS
    bool "Remember macOS/Windows separately for each Bluetooth profile"
    default y
    depends on ZMK_BLE && SETTINGS
    depends on !ZMK_SPLIT || ZMK_SPLIT_ROLE_CENTRAL
    help
      Observe the existing Windows layer toggle without changing key handling.
      The selected Bluetooth slot owns the choice even while USB is active.
      Save changes in the background, outside the input work queue.

config ADV360_SCOPED_TRACE
    bool "Explicitly armed Alt/Delete/Backspace and NUM trace"
    default n
    depends on USB_DEVICE_STACK
    help
      Temporary diagnostic build. No letters or raw HID reports are stored.
      USB serial START arms a maximum 60 second capture; DUMP stops and exports.

config ZMK_BEHAVIOR_ADV2_RESOLVER
    bool "Advantage 2 compatible key resolver"
    default y
    help
      Reproduces the modifier-aware tap/hold behavior of the original
      Advantage 2 QMK keymap on an Advantage 360 Pro.

config ZMK_BEHAVIOR_ADV360_BT_CONTROL
    bool "Sequential Advantage 360 Bluetooth control"
    default y
    depends on BT
    help
      Adds a timed Bluetooth control layer which passes ordinary input through,
      permits the NUM momentary layer, selects profiles 1-5, and clears the
      selected profile from either Delete or Backspace.

endmenu
```

## dts/bindings/behaviors/geekhunger,behavior-adv2-resolver.yaml
```yaml
description: Resolve an Advantage 2 compatible tap, hold, or navigation action

compatible: "geekhunger,behavior-adv2-resolver"

include: one_param.yaml
```

## dts/bindings/behaviors/geekhunger,behavior-adv360-bt-control.yaml
```yaml
description: Sequential Bluetooth profile control for the Advantage 360

compatible: "geekhunger,behavior-adv360-bt-control"

include: one_param.yaml
```
